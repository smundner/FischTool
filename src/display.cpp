#include "display.h"
#include <Wire.h>
#include <avr/pgmspace.h>
#include "font.h"

static uint8_t display_buffer[(128 * 64) / 8]= {
0x00, 0x00, 0x00, 0x00, 0x00, 0x00, 0x00, 0x00, 0x00, 0x00, 0x00, 0x00, 0x00, 0x00, 0x00, 0x00,
0x00, 0x00, 0x00, 0x00, 0x00, 0x00, 0x00, 0x00, 0x00, 0x00, 0x00, 0x00, 0x00, 0x00, 0x00, 0x00,
0x00, 0x00, 0x00, 0x00, 0x00, 0x00, 0x00, 0x00, 0x00, 0x00, 0x00, 0x00, 0x00, 0x00, 0x00, 0x00,
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0x00, 0x00, 0x00, 0x00, 0x00, 0x00, 0x00, 0x00, 0x00, 0x00, 0x00, 0x00, 0x00, 0x00, 0x00, 0x00
};

void drawPixel(int16_t x, int16_t y, uint16_t color) {
  //if ((x < 0) || (x >= 128) || (y < 0) || (y >= 64)){
   
  // x is which column
  
    switch (color)
    {
      case 1:   display_buffer[x+ (y/8)*128] |=  (1 << (y&7)); break;
      case 0:   display_buffer[x+ (y/8)*128] &= ~(1 << (y&7)); break;
    }
  
}
void sendCommand(byte c) {
  Wire.beginTransmission(DISPLAY_ADDRESS);
  Wire.write(0x00);
  Wire.write(c);
  Wire.endTransmission();
}

void Display::begin() {
  sendCommand(DISPLAY_DISPLAYOFF);
  sendCommand(DISPLAY_SETDISPLAYCLOCKDIV);
  sendCommand(0x80);

  sendCommand(DISPLAY_SETMULTIPLEX);
  sendCommand(63);

  sendCommand(DISPLAY_SETDISPLAYOFFSET);
  sendCommand(0x00);
  sendCommand(DISPLAY_SETSTARTLINE | 0x0);
  sendCommand(DISPLAY_CHARGEPUMP);
  sendCommand(0x14);

  sendCommand(DISPLAY_MEMORYMODE);
  sendCommand(0x00);
  sendCommand(DISPLAY_SEGREMAP | 0x1);
  sendCommand(DISPLAY_COMSCANDEC);

  sendCommand(DISPLAY_SETCOMPINS);
  sendCommand(0x12);
  sendCommand(DISPLAY_SETCONTRAST);
  sendCommand(0xCF);

  sendCommand(DISPLAY_SETPRECHARGE);
  sendCommand(0xF1);
  sendCommand(DISPLAY_SETVCOMDETECT);
  sendCommand(0x40);
  sendCommand(DISPLAY_DISPLAYALLON_RESUME);
  sendCommand(DISPLAY_NORMALDISPLAY);

  sendCommand(DISPLAY_DEACTIVATE_SCROLL);

  sendCommand(DISPLAY_DISPLAYON);
}

void Display::drawLine(byte xb, byte xe, byte yb, byte ye) {
}

void Display::clear(){
  for(int16_t i = 0;i<(128 * 64) / 8;i++){
    display_buffer[i]=0x00;
    }
  }

void Display::display() {

  sendCommand(DISPLAY_COLUMNADDR);
  sendCommand(0);
  sendCommand(127);
  sendCommand(DISPLAY_PAGEADDR);
  sendCommand(0);
  sendCommand(7);

  for (uint16_t i = 0; i < (128 * 64) / 8; i++) {
    Wire.beginTransmission(DISPLAY_ADDRESS);
    Wire.write(0x40);
    for (uint16_t j = 0; j < 16; j++) {
      Wire.write(display_buffer[i]);
      //Serial.print(i);Serial.print(": ");Serial.println(display_buffer[i]);
      i++;
    }
    i--;
    Wire.endTransmission();
  }
}

void Display::writeChars(uint8_t xoff,uint8_t yoff,char *data){
  while(*data!='\0'){
  for(int8_t i=0; i<5; i++ ) { // Char bitmap = 5 columns
    uint8_t line = pgm_read_byte(&font[*data * 5 + i]);
    for(int8_t j=0;j<7;j++,line>>=1){
      
      if(line & 1){
        drawPixel(xoff+i,yoff+j,1);
      }else{
        drawPixel(xoff+i,yoff+j,0);
        }
      }
    }
    xoff +=8;
    
    data++;
  }  
  }
void Display::writeChar(char data){
  
  }
